## boards/shields/corne_left/Kconfig.shield
```kconfig
config SHIELD_CORNE_LEFT
    def_bool $(shields_list_contains,corne_left)

config ZMK_SPLIT_ROLE_CENTRAL
    bool "Enable central role for split keyboard"
```

## boards/shields/corne_right/Kconfig.defconfig
```kconfig
if SHIELD_CORNE_RIGHT
    config ZMK_KEYBOARD_NAME
        default "Corne Right"
    config ZMK_SPLIT
        default y
endif
```

## boards/shields/corne_right/Kconfig.shield
```kconfig
config SHIELD_CORNE_RIGHT
    def_bool $(shields_list_contains,corne_right)

config ZMK_SPLIT_ROLE_PERIPHERAL
    bool "Enable peripheral role for split keyboard"
```
